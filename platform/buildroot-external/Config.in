## platform/buildroot-external/configs/netrouter_x86_64_defconfig
```kconfig
BR2_x86_64=y
BR2_TOOLCHAIN_BUILDROOT_MUSL=y
BR2_INIT_BUSYBOX=y
BR2_SYSTEM_DHCP="eth0"
BR2_ROOTFS_OVERLAY="$(BR2_EXTERNAL_NETROUTER_PATH)/board/x86_64/overlay"
BR2_LINUX_KERNEL=y
BR2_LINUX_KERNEL_LATEST_VERSION=y
BR2_LINUX_KERNEL_USE_CUSTOM_CONFIG=y
BR2_LINUX_KERNEL_CUSTOM_CONFIG_FILE="$(BR2_EXTERNAL_NETROUTER_PATH)/board/x86_64/linux.config"
BR2_LINUX_KERNEL_INSTALL_TARGET=y
BR2_PACKAGE_BUSYBOX_SHOW_OTHERS=y
BR2_PACKAGE_IPROUTE2=y
BR2_PACKAGE_NFTABLES=y
BR2_PACKAGE_DNSMASQ=y
BR2_PACKAGE_OPENSSH=y
BR2_PACKAGE_NETROUTERD=y
BR2_TARGET_ROOTFS_EXT2=y
BR2_TARGET_ROOTFS_EXT2_4=y
BR2_TARGET_SYSLINUX=y
BR2_TARGET_SYSLINUX_ISOLINUX=y
BR2_TARGET_ROOTFS_ISO9660=y
BR2_TARGET_ROOTFS_ISO9660_ISOLINUX=y
BR2_TARGET_ROOTFS_ISO9660_INITRD=y
BR2_TARGET_ROOTFS_ISO9660_HYBRID=y
```

## platform/buildroot-external/package/netrouterd/Config.in
```kconfig
config BR2_PACKAGE_NETROUTERD
	bool "netrouterd"
	depends on BR2_PACKAGE_HOST_GO_TARGET_ARCH_SUPPORTS
	select BR2_PACKAGE_IPROUTE2
	help
	  Privileged NetRouter OS management daemon. It reads system state,
	  manages validated network mutations, and serves local/optional mTLS API clients.
```
